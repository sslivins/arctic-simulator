## main/Kconfig.projbuild
```kconfig
menu "Arctic Simulator Configuration"

    config SIMULATOR_WIFI_SSID
        string "WiFi SSID (fallback)"
        default ""
        help
            Fallback WiFi SSID used only when no credentials are stored
            in NVS (i.e. the captive portal has not been used yet).
            Leave empty to always start in provisioning mode.

    config SIMULATOR_WIFI_PASSWORD
        string "WiFi Password (fallback)"
        default ""
        help
            Fallback WiFi password (paired with the SSID above).

    config SIMULATOR_WIFI_RESET_HOLD_MS
        int "Button hold time to reset WiFi (ms)"
        default 3000
        range 1000 10000
        help
            Hold the front button for this long to erase stored WiFi
            credentials and reboot into provisioning (SoftAP) mode.

    config SIMULATOR_MDNS_HOSTNAME
        string "mDNS Hostname (base)"
        default "arctic-sim"
        help
            Base mDNS hostname. On boot the device probes the network
            for collisions and appends a suffix if needed:
            arctic-sim.local, arctic-sim-2.local, arctic-sim-3.local, …

    config SIMULATOR_RS485_TX_PIN
        int "RS-485 TX GPIO"
        default 6
        help
            GPIO pin for RS-485 TX. Default 6 for Atom S3 + RS485 base.

    config SIMULATOR_RS485_RX_PIN
        int "RS-485 RX GPIO"
        default 5
        help
            GPIO pin for RS-485 RX. Default 5 for Atom S3 + RS485 base.

    config SIMULATOR_RS485_DIR_PIN
        int "RS-485 Direction GPIO (-1 for auto)"
        default -1
        help
            GPIO pin for RS-485 direction control (RTS).
            Set to -1 if the RS-485 adapter handles direction automatically.

    config SIMULATOR_UART_PORT
        int "UART Port Number"
        default 1
        range 0 2
        help
            UART port number for Modbus communication.

    config SIMULATOR_MODBUS_SLAVE_ADDR
        int "Modbus Slave Address"
        default 1
        range 1 247
        help
            Modbus slave address. The Arctic heat pump uses address 1.

endmenu

menu "Display & Button"

    config SIMULATOR_LCD_MOSI
        int "LCD MOSI GPIO"
        default 21
        help
            SPI MOSI pin for the GC9107 LCD.

    config SIMULATOR_LCD_CLK
        int "LCD CLK GPIO"
        default 15
        help
            SPI CLK pin for the GC9107 LCD.

    config SIMULATOR_LCD_CS
        int "LCD CS GPIO"
        default 14
        help
            SPI chip-select pin for the GC9107 LCD.

    config SIMULATOR_LCD_DC
        int "LCD DC (Data/Command) GPIO"
        default 42
        help
            Data/Command pin for the GC9107 LCD.

    config SIMULATOR_LCD_RST
        int "LCD Reset GPIO"
        default 48
        help
            Hardware-reset pin for the GC9107 LCD.

    config SIMULATOR_LCD_BL
        int "LCD Backlight GPIO (fallback)"
        default 16
        help
            GPIO pin for backlight on Atom S3 (non-I2C variant).
            Used only when I2C backlight is disabled or fails.

    config SIMULATOR_LCD_BL_I2C
        bool "Use I2C backlight controller (Atom S3R)"
        default y
        help
            Enable I2C-based LED backlight controller at address 0x30.
            Disable for plain Atom S3 which uses a simple GPIO.

    config SIMULATOR_LCD_BL_I2C_SDA
        int "I2C backlight SDA GPIO"
        default 45
        depends on SIMULATOR_LCD_BL_I2C
        help
            SDA pin for the I2C backlight controller.

    config SIMULATOR_LCD_BL_I2C_SCL
        int "I2C backlight SCL GPIO"
        default 0
        depends on SIMULATOR_LCD_BL_I2C
        help
            SCL pin for the I2C backlight controller.

    config SIMULATOR_BTN_GPIO
        int "Front button GPIO"
        default 41
        help
            GPIO pin for the front-face button (active-low).

endmenu

menu "Recorder"

    config SIMULATOR_RECORD_INTERVAL_MS
        int "Recording interval (ms)"
        default 500
        range 100 5000
        help
            How often to snapshot register values while recording.

endmenu
```

## sdkconfig.defaults
```kconfig
# Target: ESP32-S3 (M5Stack Atom S3)
CONFIG_IDF_TARGET="esp32s3"

# Serial flasher - Atom S3 uses USB-CDC
CONFIG_ESPTOOLPY_FLASHSIZE_4MB=y

# Wi-Fi — leave empty; credentials are set via the captive portal
# and stored in NVS.  Kconfig fallback values are in Kconfig.projbuild.
CONFIG_SIMULATOR_WIFI_SSID=""
CONFIG_SIMULATOR_WIFI_PASSWORD=""

# HTTP Server
CONFIG_HTTPD_MAX_REQ_HDR_LEN=1024
CONFIG_HTTPD_MAX_URI_LEN=512

# mDNS

# FreeRTOS
CONFIG_FREERTOS_HZ=1000

# Partition table
CONFIG_PARTITION_TABLE_CUSTOM=y
CONFIG_PARTITION_TABLE_CUSTOM_FILENAME="partitions.csv"

# Log level
CONFIG_LOG_DEFAULT_LEVEL_INFO=y
CONFIG_LOG_MAXIMUM_LEVEL_DEBUG=y

# UART for Modbus
CONFIG_UART_ISR_IN_IRAM=y
```
